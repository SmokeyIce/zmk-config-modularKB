## build/Kconfig/soc/Kconfig
```kconfig
# Load Zephyr SoC Kconfig descriptions.
osource "/Users/irinavorobieva/Documents/modKB/zephyr/soc/xlnx/zynqmp/Kconfig"
osource "/Users/irinavorobieva/Documents/modKB/zephyr/soc/xlnx/zynq7000/Kconfig"
osource "/Users/irinavorobieva/Documents/modKB/zephyr/soc/xen/Kconfig"
osource "/Users/irinavorobieva/Documents/modKB/zephyr/soc/wch/ch32v/Kconfig"
osource "/Users/irinavorobieva/Documents/modKB/zephyr/soc/ti/simplelink/Kconfig"
osource "/Users/irinavorobieva/Documents/modKB/zephyr/soc/ti/lm3s6965/Kconfig"
osource "/Users/irinavorobieva/Documents/modKB/zephyr/soc/ti/k3/Kconfig"
osource "/Users/irinavorobieva/Documents/modKB/zephyr/soc/telink/tlsr/Kconfig"
osource "/Users/irinavorobieva/Documents/modKB/zephyr/soc/starfive/jh71xx/Kconfig"
osource "/Users/irinavorobieva/Documents/modKB/zephyr/soc/st/stm32/Kconfig"
osource "/Users/irinavorobieva/Documents/modKB/zephyr/soc/snps/qemu_arc/Kconfig"
osource "/Users/irinavorobieva/Documents/modKB/zephyr/soc/snps/nsim/arc_v/Kconfig"
osource "/Users/irinavorobieva/Documents/modKB/zephyr/soc/snps/nsim/arc_classic/Kconfig"
osource "/Users/irinavorobieva/Documents/modKB/zephyr/soc/snps/hsdk4xd/Kconfig"
osource "/Users/irinavorobieva/Documents/modKB/zephyr/soc/snps/hsdk/Kconfig"
osource "/Users/irinavorobieva/Documents/modKB/zephyr/soc/snps/emsk/Kconfig"
osource "/Users/irinavorobieva/Documents/modKB/zephyr/soc/snps/emsdp/Kconfig"
osource "/Users/irinavorobieva/Documents/modKB/zephyr/soc/snps/arc_iot/Kconfig"
osource "/Users/irinavorobieva/Documents/modKB/zephyr/soc/silabs/Kconfig"
osource "/Users/irinavorobieva/Documents/modKB/zephyr/soc/sifive/sifive_freedom/Kconfig"
osource "/Users/irinavorobieva/Documents/modKB/zephyr/soc/sensry/Kconfig"
osource "/Users/irinavorobieva/Documents/modKB/zephyr/soc/rockchip/Kconfig"
osource "/Users/irinavorobieva/Documents/modKB/zephyr/soc/renode/riscv_virtual/Kconfig"
osource "/Users/irinavorobieva/Documents/modKB/zephyr/soc/renode/cortex_r8_virtual/Kconfig"
osource "/Users/irinavorobieva/Documents/modKB/zephyr/soc/renesas/smartbond/Kconfig"
osource "/Users/irinavorobieva/Documents/modKB/zephyr/soc/renesas/rzt2m/Kconfig"
osource "/Users/irinavorobieva/Documents/modKB/zephyr/soc/renesas/rz/Kconfig"
osource "/Users/irinavorobieva/Documents/modKB/zephyr/soc/renesas/rcar/Kconfig"
osource "/Users/irinavorobieva/Documents/modKB/zephyr/soc/renesas/ra/Kconfig"
osource "/Users/irinavorobieva/Documents/modKB/zephyr/soc/realtek/ec/Kconfig"
osource "/Users/irinavorobieva/Documents/modKB/zephyr/soc/raspberrypi/rpi_pico/Kconfig"
osource "/Users/irinavorobieva/Documents/modKB/zephyr/soc/quicklogic/eos_s3/Kconfig"
osource "/Users/irinavorobieva/Documents/modKB/zephyr/soc/qemu/virt_riscv/Kconfig"
osource "/Users/irinavorobieva/Documents/modKB/zephyr/soc/qemu/malta/Kconfig"
osource "/Users/irinavorobieva/Documents/modKB/zephyr/soc/openisa/rv32m1/Kconfig"
osource "/Users/irinavorobieva/Documents/modKB/zephyr/soc/nxp/s32/Kconfig"
osource "/Users/irinavorobieva/Documents/modKB/zephyr/soc/nxp/rw/Kconfig"
osource "/Users/irinavorobieva/Documents/modKB/zephyr/soc/nxp/mcx/Kconfig"
osource "/Users/irinavorobieva/Documents/modKB/zephyr/soc/nxp/lpc/Kconfig"
osource "/Users/irinavorobieva/Documents/modKB/zephyr/soc/nxp/layerscape/Kconfig"
osource "/Users/irinavorobieva/Documents/modKB/zephyr/soc/nxp/kinetis/Kconfig"
osource "/Users/irinavorobieva/Documents/modKB/zephyr/soc/nxp/imxrt/Kconfig"
osource "/Users/irinavorobieva/Documents/modKB/zephyr/soc/nxp/imx/Kconfig"
osource "/Users/irinavorobieva/Documents/modKB/zephyr/soc/nuvoton/numicro/Kconfig"
osource "/Users/irinavorobieva/Documents/modKB/zephyr/soc/nuvoton/numaker/Kconfig"
osource "/Users/irinavorobieva/Documents/modKB/zephyr/soc/nuvoton/npcx/Kconfig"
osource "/Users/irinavorobieva/Documents/modKB/zephyr/soc/nuvoton/npcm/Kconfig"
osource "/Users/irinavorobieva/Documents/modKB/zephyr/soc/nordic/Kconfig"
osource "/Users/irinavorobieva/Documents/modKB/zephyr/soc/neorv32/Kconfig"
osource "/Users/irinavorobieva/Documents/modKB/zephyr/soc/native/inf_clock/Kconfig"
osource "/Users/irinavorobieva/Documents/modKB/zephyr/soc/microchip/miv/Kconfig"
osource "/Users/irinavorobieva/Documents/modKB/zephyr/soc/microchip/mec/Kconfig"
osource "/Users/irinavorobieva/Documents/modKB/zephyr/soc/mediatek/mt8xxx/Kconfig"
osource "/Users/irinavorobieva/Documents/modKB/zephyr/soc/lowrisc/opentitan/Kconfig"
osource "/Users/irinavorobieva/Documents/modKB/zephyr/soc/litex/litex_vexriscv/Kconfig"
osource "/Users/irinavorobieva/Documents/modKB/zephyr/soc/ite/ec/Kconfig"
osource "/Users/irinavorobieva/Documents/modKB/zephyr/soc/intel/raptor_lake/Kconfig"
osource "/Users/irinavorobieva/Documents/modKB/zephyr/soc/intel/lakemont/Kconfig"
osource "/Users/irinavorobieva/Documents/modKB/zephyr/soc/intel/intel_socfpga_std/Kconfig"
osource "/Users/irinavorobieva/Documents/modKB/zephyr/soc/intel/intel_socfpga/Kconfig"
osource "/Users/irinavorobieva/Documents/modKB/zephyr/soc/intel/intel_niosv/Kconfig"
osource "/Users/irinavorobieva/Documents/modKB/zephyr/soc/intel/intel_ish/Kconfig"
osource "/Users/irinavorobieva/Documents/modKB/zephyr/soc/intel/intel_adsp/Kconfig"
osource "/Users/irinavorobieva/Documents/modKB/zephyr/soc/intel/elkhart_lake/Kconfig"
osource "/Users/irinavorobieva/Documents/modKB/zephyr/soc/intel/atom/Kconfig"
osource "/Users/irinavorobieva/Documents/modKB/zephyr/soc/intel/apollo_lake/Kconfig"
osource "/Users/irinavorobieva/Documents/modKB/zephyr/soc/intel/alder_lake/Kconfig"
osource "/Users/irinavorobieva/Documents/modKB/zephyr/soc/infineon/cat3/Kconfig"
osource "/Users/irinavorobieva/Documents/modKB/zephyr/soc/infineon/cat1b/Kconfig"
osource "/Users/irinavorobieva/Documents/modKB/zephyr/soc/infineon/cat1a/Kconfig"
osource "/Users/irinavorobieva/Documents/modKB/zephyr/soc/gd/gd32/Kconfig"
osource "/Users/irinavorobieva/Documents/modKB/zephyr/soc/gaisler/leon3/Kconfig"
osource "/Users/irinavorobieva/Documents/modKB/zephyr/soc/gaisler/gr716a/Kconfig"
osource "/Users/irinavorobieva/Documents/modKB/zephyr/soc/espressif/Kconfig"
osource "/Users/irinavorobieva/Documents/modKB/zephyr/soc/ene/kb1200/Kconfig"
osource "/Users/irinavorobieva/Documents/modKB/zephyr/soc/efinix/sapphire/Kconfig"
osource "/Users/irinavorobieva/Documents/modKB/zephyr/soc/cdns/xtensa_sample_controller/Kconfig"
osource "/Users/irinavorobieva/Documents/modKB/zephyr/soc/cdns/sample_controller32/Kconfig"
osource "/Users/irinavorobieva/Documents/modKB/zephyr/soc/cdns/dc233c/Kconfig"
osource "/Users/irinavorobieva/Documents/modKB/zephyr/soc/brcm/bcmvk/Kconfig"
osource "/Users/irinavorobieva/Documents/modKB/zephyr/soc/brcm/bcm2712/Kconfig"
osource "/Users/irinavorobieva/Documents/modKB/zephyr/soc/brcm/bcm2711/Kconfig"
osource "/Users/irinavorobieva/Documents/modKB/zephyr/soc/atmel/sam0/Kconfig"
osource "/Users/irinavorobieva/Documents/modKB/zephyr/soc/atmel/sam/Kconfig"
osource "/Users/irinavorobieva/Documents/modKB/zephyr/soc/aspeed/Kconfig"
osource "/Users/irinavorobieva/Documents/modKB/zephyr/soc/arm/Kconfig"
osource "/Users/irinavorobieva/Documents/modKB/zephyr/soc/arm/beetle/Kconfig"
osource "/Users/irinavorobieva/Documents/modKB/zephyr/soc/antmicro/myra/Kconfig"
osource "/Users/irinavorobieva/Documents/modKB/zephyr/soc/andestech/Kconfig"
osource "/Users/irinavorobieva/Documents/modKB/zephyr/soc/amd/acp_6_0/Kconfig"
osource "/Users/irinavorobieva/Documents/modKB/zephyr/soc/ambiq/Kconfig"
osource "/Users/irinavorobieva/Documents/modKB/zephyr/soc/altr/zephyr_nios2f/Kconfig"
osource "/Users/irinavorobieva/Documents/modKB/zephyr/soc/altr/qemu_nios2/Kconfig"
osource "/Users/irinavorobieva/Documents/modKB/zephyr/soc/adi/max32/Kconfig"
```

## build/Kconfig/soc/Kconfig.soc
```kconfig
# Load SoC Kconfig descriptions.
osource "/Users/irinavorobieva/Documents/modKB/zephyr/soc/xlnx/zynqmp/Kconfig.soc"
osource "/Users/irinavorobieva/Documents/modKB/zephyr/soc/xlnx/zynq7000/Kconfig.soc"
osource "/Users/irinavorobieva/Documents/modKB/zephyr/soc/xen/Kconfig.soc"
osource "/Users/irinavorobieva/Documents/modKB/zephyr/soc/wch/ch32v/Kconfig.soc"
osource "/Users/irinavorobieva/Documents/modKB/zephyr/soc/ti/simplelink/Kconfig.soc"
osource "/Users/irinavorobieva/Documents/modKB/zephyr/soc/ti/lm3s6965/Kconfig.soc"
osource "/Users/irinavorobieva/Documents/modKB/zephyr/soc/ti/k3/Kconfig.soc"
osource "/Users/irinavorobieva/Documents/modKB/zephyr/soc/telink/tlsr/Kconfig.soc"
osource "/Users/irinavorobieva/Documents/modKB/zephyr/soc/starfive/jh71xx/Kconfig.soc"
osource "/Users/irinavorobieva/Documents/modKB/zephyr/soc/st/stm32/Kconfig.soc"
osource "/Users/irinavorobieva/Documents/modKB/zephyr/soc/snps/qemu_arc/Kconfig.soc"
osource "/Users/irinavorobieva/Documents/modKB/zephyr/soc/snps/nsim/arc_v/Kconfig.soc"
osource "/Users/irinavorobieva/Documents/modKB/zephyr/soc/snps/nsim/arc_classic/Kconfig.soc"
osource "/Users/irinavorobieva/Documents/modKB/zephyr/soc/snps/hsdk4xd/Kconfig.soc"
osource "/Users/irinavorobieva/Documents/modKB/zephyr/soc/snps/hsdk/Kconfig.soc"
osource "/Users/irinavorobieva/Documents/modKB/zephyr/soc/snps/emsk/Kconfig.soc"
osource "/Users/irinavorobieva/Documents/modKB/zephyr/soc/snps/emsdp/Kconfig.soc"
osource "/Users/irinavorobieva/Documents/modKB/zephyr/soc/snps/arc_iot/Kconfig.soc"
osource "/Users/irinavorobieva/Documents/modKB/zephyr/soc/silabs/Kconfig.soc"
osource "/Users/irinavorobieva/Documents/modKB/zephyr/soc/sifive/sifive_freedom/Kconfig.soc"
osource "/Users/irinavorobieva/Documents/modKB/zephyr/soc/sensry/Kconfig.soc"
osource "/Users/irinavorobieva/Documents/modKB/zephyr/soc/rockchip/Kconfig.soc"
osource "/Users/irinavorobieva/Documents/modKB/zephyr/soc/renode/riscv_virtual/Kconfig.soc"
osource "/Users/irinavorobieva/Documents/modKB/zephyr/soc/renode/cortex_r8_virtual/Kconfig.soc"
osource "/Users/irinavorobieva/Documents/modKB/zephyr/soc/renesas/smartbond/Kconfig.soc"
osource "/Users/irinavorobieva/Documents/modKB/zephyr/soc/renesas/rzt2m/Kconfig.soc"
osource "/Users/irinavorobieva/Documents/modKB/zephyr/soc/renesas/rz/Kconfig.soc"
osource "/Users/irinavorobieva/Documents/modKB/zephyr/soc/renesas/rcar/Kconfig.soc"
osource "/Users/irinavorobieva/Documents/modKB/zephyr/soc/renesas/ra/Kconfig.soc"
osource "/Users/irinavorobieva/Documents/modKB/zephyr/soc/realtek/ec/Kconfig.soc"
osource "/Users/irinavorobieva/Documents/modKB/zephyr/soc/raspberrypi/rpi_pico/Kconfig.soc"
osource "/Users/irinavorobieva/Documents/modKB/zephyr/soc/quicklogic/eos_s3/Kconfig.soc"
osource "/Users/irinavorobieva/Documents/modKB/zephyr/soc/qemu/virt_riscv/Kconfig.soc"
osource "/Users/irinavorobieva/Documents/modKB/zephyr/soc/qemu/malta/Kconfig.soc"
osource "/Users/irinavorobieva/Documents/modKB/zephyr/soc/openisa/rv32m1/Kconfig.soc"
osource "/Users/irinavorobieva/Documents/modKB/zephyr/soc/nxp/s32/Kconfig.soc"
osource "/Users/irinavorobieva/Documents/modKB/zephyr/soc/nxp/rw/Kconfig.soc"
osource "/Users/irinavorobieva/Documents/modKB/zephyr/soc/nxp/mcx/Kconfig.soc"
osource "/Users/irinavorobieva/Documents/modKB/zephyr/soc/nxp/lpc/Kconfig.soc"
osource "/Users/irinavorobieva/Documents/modKB/zephyr/soc/nxp/layerscape/Kconfig.soc"
osource "/Users/irinavorobieva/Documents/modKB/zephyr/soc/nxp/kinetis/Kconfig.soc"
osource "/Users/irinavorobieva/Documents/modKB/zephyr/soc/nxp/imxrt/Kconfig.soc"
osource "/Users/irinavorobieva/Documents/modKB/zephyr/soc/nxp/imx/Kconfig.soc"
osource "/Users/irinavorobieva/Documents/modKB/zephyr/soc/nuvoton/numicro/Kconfig.soc"
osource "/Users/irinavorobieva/Documents/modKB/zephyr/soc/nuvoton/numaker/Kconfig.soc"
osource "/Users/irinavorobieva/Documents/modKB/zephyr/soc/nuvoton/npcx/Kconfig.soc"
osource "/Users/irinavorobieva/Documents/modKB/zephyr/soc/nuvoton/npcm/Kconfig.soc"
osource "/Users/irinavorobieva/Documents/modKB/zephyr/soc/nordic/Kconfig.soc"
osource "/Users/irinavorobieva/Documents/modKB/zephyr/soc/neorv32/Kconfig.soc"
osource "/Users/irinavorobieva/Documents/modKB/zephyr/soc/native/inf_clock/Kconfig.soc"
osource "/Users/irinavorobieva/Documents/modKB/zephyr/soc/microchip/miv/Kconfig.soc"
osource "/Users/irinavorobieva/Documents/modKB/zephyr/soc/microchip/mec/Kconfig.soc"
osource "/Users/irinavorobieva/Documents/modKB/zephyr/soc/mediatek/mt8xxx/Kconfig.soc"
osource "/Users/irinavorobieva/Documents/modKB/zephyr/soc/lowrisc/opentitan/Kconfig.soc"
osource "/Users/irinavorobieva/Documents/modKB/zephyr/soc/litex/litex_vexriscv/Kconfig.soc"
osource "/Users/irinavorobieva/Documents/modKB/zephyr/soc/ite/ec/Kconfig.soc"
osource "/Users/irinavorobieva/Documents/modKB/zephyr/soc/intel/raptor_lake/Kconfig.soc"
osource "/Users/irinavorobieva/Documents/modKB/zephyr/soc/intel/lakemont/Kconfig.soc"
osource "/Users/irinavorobieva/Documents/modKB/zephyr/soc/intel/intel_socfpga_std/Kconfig.soc"
osource "/Users/irinavorobieva/Documents/modKB/zephyr/soc/intel/intel_socfpga/Kconfig.soc"
osource "/Users/irinavorobieva/Documents/modKB/zephyr/soc/intel/intel_niosv/Kconfig.soc"
osource "/Users/irinavorobieva/Documents/modKB/zephyr/soc/intel/intel_ish/Kconfig.soc"
osource "/Users/irinavorobieva/Documents/modKB/zephyr/soc/intel/intel_adsp/Kconfig.soc"
osource "/Users/irinavorobieva/Documents/modKB/zephyr/soc/intel/elkhart_lake/Kconfig.soc"
osource "/Users/irinavorobieva/Documents/modKB/zephyr/soc/intel/atom/Kconfig.soc"
osource "/Users/irinavorobieva/Documents/modKB/zephyr/soc/intel/apollo_lake/Kconfig.soc"
osource "/Users/irinavorobieva/Documents/modKB/zephyr/soc/intel/alder_lake/Kconfig.soc"
osource "/Users/irinavorobieva/Documents/modKB/zephyr/soc/infineon/cat3/Kconfig.soc"
osource "/Users/irinavorobieva/Documents/modKB/zephyr/soc/infineon/cat1b/Kconfig.soc"
osource "/Users/irinavorobieva/Documents/modKB/zephyr/soc/infineon/cat1a/Kconfig.soc"
osource "/Users/irinavorobieva/Documents/modKB/zephyr/soc/gd/gd32/Kconfig.soc"
osource "/Users/irinavorobieva/Documents/modKB/zephyr/soc/gaisler/leon3/Kconfig.soc"
osource "/Users/irinavorobieva/Documents/modKB/zephyr/soc/gaisler/gr716a/Kconfig.soc"
osource "/Users/irinavorobieva/Documents/modKB/zephyr/soc/espressif/Kconfig.soc"
osource "/Users/irinavorobieva/Documents/modKB/zephyr/soc/ene/kb1200/Kconfig.soc"
osource "/Users/irinavorobieva/Documents/modKB/zephyr/soc/efinix/sapphire/Kconfig.soc"
osource "/Users/irinavorobieva/Documents/modKB/zephyr/soc/cdns/xtensa_sample_controller/Kconfig.soc"
osource "/Users/irinavorobieva/Documents/modKB/zephyr/soc/cdns/sample_controller32/Kconfig.soc"
osource "/Users/irinavorobieva/Documents/modKB/zephyr/soc/cdns/dc233c/Kconfig.soc"
osource "/Users/irinavorobieva/Documents/modKB/zephyr/soc/brcm/bcmvk/Kconfig.soc"
osource "/Users/irinavorobieva/Documents/modKB/zephyr/soc/brcm/bcm2712/Kconfig.soc"
osource "/Users/irinavorobieva/Documents/modKB/zephyr/soc/brcm/bcm2711/Kconfig.soc"
osource "/Users/irinavorobieva/Documents/modKB/zephyr/soc/atmel/sam0/Kconfig.soc"
osource "/Users/irinavorobieva/Documents/modKB/zephyr/soc/atmel/sam/Kconfig.soc"
osource "/Users/irinavorobieva/Documents/modKB/zephyr/soc/aspeed/Kconfig.soc"
osource "/Users/irinavorobieva/Documents/modKB/zephyr/soc/arm/Kconfig.soc"
osource "/Users/irinavorobieva/Documents/modKB/zephyr/soc/arm/beetle/Kconfig.soc"
osource "/Users/irinavorobieva/Documents/modKB/zephyr/soc/antmicro/myra/Kconfig.soc"
osource "/Users/irinavorobieva/Documents/modKB/zephyr/soc/andestech/Kconfig.soc"
osource "/Users/irinavorobieva/Documents/modKB/zephyr/soc/amd/acp_6_0/Kconfig.soc"
osource "/Users/irinavorobieva/Documents/modKB/zephyr/soc/ambiq/Kconfig.soc"
osource "/Users/irinavorobieva/Documents/modKB/zephyr/soc/altr/zephyr_nios2f/Kconfig.soc"
osource "/Users/irinavorobieva/Documents/modKB/zephyr/soc/altr/qemu_nios2/Kconfig.soc"
osource "/Users/irinavorobieva/Documents/modKB/zephyr/soc/adi/max32/Kconfig.soc"
```

## config/boards/shields/modKB/Kconfig.shield
```kconfig
config SHEILD_MODKB
    def_bool $(shields_list_contains, ModKB_KP, ModKB_LH, ModKB_RH)
```
