## build/Kconfig/Kconfig.modules
```kconfig
config ZEPHYR_HAL_STM32_MODULE
	bool
	default y

config ZEPHYR_HAL_STM32_MODULE_BLOBS
	bool
menu "lvgl (/Users/irinavorobieva/Documents/modKB/modules/lib/gui/lvgl)"
osource "/Users/irinavorobieva/Documents/modKB/modules/lib/gui/lvgl/zephyr/Kconfig"
config ZEPHYR_LVGL_MODULE
	bool
	default y
endmenu
config ZEPHYR_ZMK_STUDIO_MESSAGES_MODULE
	bool
	default y
menu "canopennode (/Users/irinavorobieva/Documents/modKB/modules/lib/canopennode)"
osource "$(ZEPHYR_CANOPENNODE_KCONFIG)"
config ZEPHYR_CANOPENNODE_MODULE
	bool
	default y
endmenu
menu "chre (/Users/irinavorobieva/Documents/modKB/modules/lib/chre)"
osource "/Users/irinavorobieva/Documents/modKB/modules/lib/chre/platform/zephyr/Kconfig"
config ZEPHYR_CHRE_MODULE
	bool
	default y
endmenu
menu "lz4 (/Users/irinavorobieva/Documents/modKB/modules/lib/lz4)"
osource "$(ZEPHYR_LZ4_KCONFIG)"
config ZEPHYR_LZ4_MODULE
	bool
	default y
endmenu
menu "nanopb (/Users/irinavorobieva/Documents/modKB/modules/lib/nanopb)"
osource "$(ZEPHYR_NANOPB_KCONFIG)"
config ZEPHYR_NANOPB_MODULE
	bool
	default y
endmenu
config ZEPHYR_PSA_ARCH_TESTS_MODULE
	bool
	default y
menu "sof (/Users/irinavorobieva/Documents/modKB/modules/audio/sof)"
osource "/Users/irinavorobieva/Documents/modKB/modules/audio/sof/zephyr/Kconfig"
config ZEPHYR_SOF_MODULE
	bool
	default y
endmenu
config ZEPHYR_TF_M_TESTS_MODULE
	bool
	default y
menu "tflite-micro (/Users/irinavorobieva/Documents/modKB/optional/modules/lib/tflite-micro)"
osource "$(ZEPHYR_TFLITE_MICRO_KCONFIG)"
config ZEPHYR_TFLITE_MICRO_MODULE
	bool
	default y
endmenu
menu "thrift (/Users/irinavorobieva/Documents/modKB/optional/modules/lib/thrift)"
osource "$(ZEPHYR_THRIFT_KCONFIG)"
config ZEPHYR_THRIFT_MODULE
	bool
	default y
endmenu
menu "lang-rust (/Users/irinavorobieva/Documents/modKB/modules/lang/rust)"
osource "/Users/irinavorobieva/Documents/modKB/modules/lang/rust/Kconfig"
config ZEPHYR_LANG_RUST_MODULE
	bool
	default y
endmenu
menu "zscilib (/Users/irinavorobieva/Documents/modKB/modules/lib/zscilib)"
osource "/Users/irinavorobieva/Documents/modKB/modules/lib/zscilib/Kconfig.zscilib"
config ZEPHYR_ZSCILIB_MODULE
	bool
	default y
endmenu
menu "acpica (/Users/irinavorobieva/Documents/modKB/modules/lib/acpica)"
osource "$(ZEPHYR_ACPICA_KCONFIG)"
config ZEPHYR_ACPICA_MODULE
	bool
	default y
endmenu
menu "cmsis (/Users/irinavorobieva/Documents/modKB/modules/hal/cmsis)"
osource "$(ZEPHYR_CMSIS_KCONFIG)"
config ZEPHYR_CMSIS_MODULE
	bool
	default y
endmenu
menu "cmsis-dsp (/Users/irinavorobieva/Documents/modKB/modules/lib/cmsis-dsp)"
osource "$(ZEPHYR_CMSIS_DSP_KCONFIG)"
config ZEPHYR_CMSIS_DSP_MODULE
	bool
	default y
endmenu
menu "cmsis-nn (/Users/irinavorobieva/Documents/modKB/modules/lib/cmsis-nn)"
osource "$(ZEPHYR_CMSIS_NN_KCONFIG)"
config ZEPHYR_CMSIS_NN_MODULE
	bool
	default y
endmenu
menu "fatfs (/Users/irinavorobieva/Documents/modKB/modules/fs/fatfs)"
osource "$(ZEPHYR_FATFS_KCONFIG)"
config ZEPHYR_FATFS_MODULE
	bool
	default y
endmenu
config ZEPHYR_ADI_MODULE
	bool
	default y
menu "hal_ambiq (/Users/irinavorobieva/Documents/modKB/modules/hal/ambiq)"
osource "$(ZEPHYR_HAL_AMBIQ_KCONFIG)"
config ZEPHYR_HAL_AMBIQ_MODULE
	bool
	default y
endmenu
config ZEPHYR_ATMEL_MODULE
	bool
	default y
menu "hal_espressif (/Users/irinavorobieva/Documents/modKB/modules/hal/espressif)"
osource "/Users/irinavorobieva/Documents/modKB/modules/hal/espressif/zephyr/Kconfig"
config ZEPHYR_HAL_ESPRESSIF_MODULE
	bool
	default y

config ZEPHYR_HAL_ESPRESSIF_MODULE_BLOBS
	bool
endmenu
menu "hal_ethos_u (/Users/irinavorobieva/Documents/modKB/modules/hal/ethos_u)"
osource "$(ZEPHYR_HAL_ETHOS_U_KCONFIG)"
config ZEPHYR_HAL_ETHOS_U_MODULE
	bool
	default y
endmenu
menu "hal_gigadevice (/Users/irinavorobieva/Documents/modKB/modules/hal/gigadevice)"
osource "$(ZEPHYR_HAL_GIGADEVICE_KCONFIG)"
config ZEPHYR_HAL_GIGADEVICE_MODULE
	bool
	default y
endmenu
menu "hal_intel (/Users/irinavorobieva/Documents/modKB/modules/hal/intel)"
osource "/Users/irinavorobieva/Documents/modKB/modules/hal/intel/zephyr/Kconfig"
config ZEPHYR_HAL_INTEL_MODULE
	bool
	default y
endmenu
menu "hal_nordic (/Users/irinavorobieva/Documents/modKB/modules/hal/nordic)"
osource "$(ZEPHYR_HAL_NORDIC_KCONFIG)"
config ZEPHYR_HAL_NORDIC_MODULE
	bool
	default y

config ZEPHYR_HAL_NORDIC_MODULE_BLOBS
	bool
endmenu
config ZEPHYR_NUVOTON_MODULE
	bool
	default y
config ZEPHYR_QUICKLOGIC_MODULE
	bool
	default y
config ZEPHYR_HAL_RENESAS_MODULE
	bool
	default y

config ZEPHYR_HAL_RENESAS_MODULE_BLOBS
	bool
menu "hal_rpi_pico (/Users/irinavorobieva/Documents/modKB/modules/hal/rpi_pico)"
osource "$(ZEPHYR_HAL_RPI_PICO_KCONFIG)"
config ZEPHYR_HAL_RPI_PICO_MODULE
	bool
	default y
endmenu
menu "hal_silabs (/Users/irinavorobieva/Documents/modKB/modules/hal/silabs)"
osource "$(ZEPHYR_HAL_SILABS_KCONFIG)"
config ZEPHYR_HAL_SILABS_MODULE
	bool
	default y

config ZEPHYR_HAL_SILABS_MODULE_BLOBS
	bool
endmenu
menu "hal_tdk (/Users/irinavorobieva/Documents/modKB/modules/hal/tdk)"
osource "$(ZEPHYR_HAL_TDK_KCONFIG)"
config ZEPHYR_HAL_TDK_MODULE
	bool
	default y
endmenu
menu "hal_telink (/Users/irinavorobieva/Documents/modKB/modules/hal/telink)"
osource "/Users/irinavorobieva/Documents/modKB/modules/hal/telink/Kconfig"
config ZEPHYR_HAL_TELINK_MODULE
	bool
	default y
endmenu
menu "hal_wch (/Users/irinavorobieva/Documents/modKB/modules/hal/wch)"
osource "$(ZEPHYR_HAL_WCH_KCONFIG)"
config ZEPHYR_HAL_WCH_MODULE
	bool
	default y
endmenu
config ZEPHYR_HAL_WURTHELEKTRONIK_MODULE
	bool
	default y
menu "hostap (/Users/irinavorobieva/Documents/modKB/modules/lib/hostap)"
osource "$(ZEPHYR_HOSTAP_KCONFIG)"
config ZEPHYR_HOSTAP_MODULE
	bool
	default y
endmenu
menu "liblc3 (/Users/irinavorobieva/Documents/modKB/modules/lib/liblc3)"
osource "$(ZEPHYR_LIBLC3_KCONFIG)"
config ZEPHYR_LIBLC3_MODULE
	bool
	default y
endmenu
config ZEPHYR_LIBMCTP_MODULE
	bool
	default y
config ZEPHYR_LIBMETAL_MODULE
	bool
	default y
menu "littlefs (/Users/irinavorobieva/Documents/modKB/modules/fs/littlefs)"
osource "$(ZEPHYR_LITTLEFS_KCONFIG)"
config ZEPHYR_LITTLEFS_MODULE
	bool
	default y
endmenu
menu "mbedtls (/Users/irinavorobieva/Documents/modKB/modules/crypto/mbedtls)"
osource "$(ZEPHYR_MBEDTLS_KCONFIG)"
config ZEPHYR_MBEDTLS_MODULE
	bool
	default y
endmenu
config ZEPHYR_MIPI_SYS_T_MODULE
	bool
	default y
menu "nrf_wifi (/Users/irinavorobieva/Documents/modKB/modules/lib/nrf_wifi)"
osource "$(ZEPHYR_NRF_WIFI_KCONFIG)"
config ZEPHYR_NRF_WIFI_MODULE
	bool
	default y

config ZEPHYR_NRF_WIFI_MODULE_BLOBS
	bool
endmenu
config ZEPHYR_OPEN_AMP_MODULE
	bool
	default y
menu "percepio (/Users/irinavorobieva/Documents/modKB/modules/debug/percepio)"
osource "/Users/irinavorobieva/Documents/modKB/modules/debug/percepio/zephyr/Kconfig"
config ZEPHYR_PERCEPIO_MODULE
	bool
	default y
endmenu
menu "picolibc (/Users/irinavorobieva/Documents/modKB/modules/lib/picolibc)"
osource "/Users/irinavorobieva/Documents/modKB/modules/lib/picolibc/zephyr/Kconfig"
config ZEPHYR_PICOLIBC_MODULE
	bool
	default y
endmenu
menu "segger (/Users/irinavorobieva/Documents/modKB/modules/debug/segger)"
osource "$(ZEPHYR_SEGGER_KCONFIG)"
config ZEPHYR_SEGGER_MODULE
	bool
	default y
endmenu
config ZEPHYR_TINYCRYPT_MODULE
	bool
	default y
menu "trusted-firmware-a (/Users/irinavorobieva/Documents/modKB/modules/tee/tf-a/trusted-firmware-a)"
osource "$(ZEPHYR_TRUSTED_FIRMWARE_A_KCONFIG)"
config ZEPHYR_TRUSTED_FIRMWARE_A_MODULE
	bool
	default y
endmenu
menu "uoscore-uedhoc (/Users/irinavorobieva/Documents/modKB/modules/lib/uoscore-uedhoc)"
osource "$(ZEPHYR_UOSCORE_UEDHOC_KCONFIG)"
config ZEPHYR_UOSCORE_UEDHOC_MODULE
	bool
	default y
endmenu
menu "zcbor (/Users/irinavorobieva/Documents/modKB/modules/lib/zcbor)"
osource "$(ZEPHYR_ZCBOR_KCONFIG)"
config ZEPHYR_ZCBOR_MODULE
	bool
	default y
endmenu
config ZEPHYR_ZMK_KEYBOARD_MODKB_MODULE
	bool
	default y
menu "module (/Users/irinavorobieva/Documents/modKB/zmk/app/module)"
osource "/Users/irinavorobieva/Documents/modKB/zmk/app/module/Kconfig"
config ZEPHYR_MODULE_MODULE
	bool
	default y
endmenu
config ZEPHYR_KEYMAP_MODULE_MODULE
	bool
	default y
config ZEPHYR_NRF_HW_MODELS_MODULE
	bool
	default y
```

## build/Kconfig/Kconfig.shield
```kconfig
osource "/Users/irinavorobieva/Documents/modKB/modkb-zmk-module/boards/shields/*/Kconfig.shield"
osource "/Users/irinavorobieva/Documents/modKB/zmk/app/module/boards/shields/*/Kconfig.shield"
osource "/Users/irinavorobieva/Documents/modKB/zmk/app/boards/shields/*/Kconfig.shield"
```

## build/Kconfig/Kconfig.shield.defconfig
```kconfig
osource "/Users/irinavorobieva/Documents/modKB/modkb-zmk-module/boards/shields/*/Kconfig.defconfig"
osource "/Users/irinavorobieva/Documents/modKB/zmk/app/module/boards/shields/*/Kconfig.defconfig"
osource "/Users/irinavorobieva/Documents/modKB/zmk/app/boards/shields/*/Kconfig.defconfig"
```

## build/Kconfig/arch/Kconfig
```kconfig
# Load Zephyr Arch Kconfig descriptions.
osource "/Users/irinavorobieva/Documents/modKB/zephyr/arch/x86/Kconfig"
osource "/Users/irinavorobieva/Documents/modKB/zephyr/arch/xtensa/Kconfig"
osource "/Users/irinavorobieva/Documents/modKB/zephyr/arch/sparc/Kconfig"
osource "/Users/irinavorobieva/Documents/modKB/zephyr/arch/riscv/Kconfig"
osource "/Users/irinavorobieva/Documents/modKB/zephyr/arch/posix/Kconfig"
osource "/Users/irinavorobieva/Documents/modKB/zephyr/arch/nios2/Kconfig"
osource "/Users/irinavorobieva/Documents/modKB/zephyr/arch/mips/Kconfig"
osource "/Users/irinavorobieva/Documents/modKB/zephyr/arch/arm64/Kconfig"
osource "/Users/irinavorobieva/Documents/modKB/zephyr/arch/arm/Kconfig"
osource "/Users/irinavorobieva/Documents/modKB/zephyr/arch/arc/Kconfig"
```

## build/Kconfig/boards/Kconfig
```kconfig
# Load Zephyr board Kconfig descriptions.
osource "/Users/irinavorobieva/Documents/modKB/zmk/app/boards/arm/nice_nano/Kconfig"
osource "/Users/irinavorobieva/Documents/modKB/zmk/app/module/boards/nicekeyboards/nice_nano/Kconfig"
osource "/Users/irinavorobieva/Documents/modKB/zmk/app/boards/nicekeyboards/nice_nano/Kconfig"
```

## build/Kconfig/boards/Kconfig.nice_nano
```kconfig
# Load board Kconfig descriptions.
osource "/Users/irinavorobieva/Documents/modKB/zmk/app/boards/arm/nice_nano/Kconfig.nice_nano"
osource "/Users/irinavorobieva/Documents/modKB/zmk/app/module/boards/nicekeyboards/nice_nano/Kconfig.nice_nano"
osource "/Users/irinavorobieva/Documents/modKB/zmk/app/boards/nicekeyboards/nice_nano/Kconfig.nice_nano"
```

## build/Kconfig/boards/Kconfig.sysbuild
```kconfig
# Load Sysbuild board Kconfig descriptions.
osource "/Users/irinavorobieva/Documents/modKB/zmk/app/boards/arm/nice_nano/Kconfig.sysbuild"
osource "/Users/irinavorobieva/Documents/modKB/zmk/app/module/boards/nicekeyboards/nice_nano/Kconfig.sysbuild"
osource "/Users/irinavorobieva/Documents/modKB/zmk/app/boards/nicekeyboards/nice_nano/Kconfig.sysbuild"
```
