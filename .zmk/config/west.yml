## modkb-zmk-module/boards/shields/modKB/Kconfig.defconfig
```kconfig
# board naming and other settings
# Reference corne
# "#" is a comment, // is not a valid token for Kconfig files



if SHIELD_MODKB_DONGLE
config ZMK_KEYBOARD_NAME
    default "ModularKeyboard"

config ZMK_SPLIT
    default y
    
config ZMK_SPLIT_ROLE_CENTRAL
    default y

config ZMK_SPLIT_BLE_CENTRAL_PERIPHERALS
    default 3

config BT_MAX_CONN
    default 8

config BT_MAX_PAIRED
    default 8 
endif

if SHIELD_MODKB_LH || SHIELD_MODKB_RH || SHIELD_MODKB_KP
config ZMK_SPLIT
    default y
endif 
```

## modkb-zmk-module/boards/shields/modKB/Kconfig.shield
```kconfig
config SHIELD_MODKB_DONGLE
    def_bool $(shields_list_contains,ModKB_dongle)

config SHIELD_MODKB_LH
    def_bool $(shields_list_contains,ModKB_LH)

config SHIELD_MODKB_RH
    def_bool $(shields_list_contains,ModKB_RH)

config SHIELD_MODKB_KP
    def_bool $(shields_list_contains,ModKB_KP)
```
